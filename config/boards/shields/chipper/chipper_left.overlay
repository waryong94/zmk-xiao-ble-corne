/*
 * Copyright (c) 2020 Pete Johanson
 *
 * SPDX-License-Identifier: MIT
 */

#include "chipper.dtsi"

&kscan0 {
	col-gpios
		= <&gpio0 4 GPIO_ACTIVE_HIGH>   //Col0
		, <&gpio0 5 GPIO_ACTIVE_HIGH>   //Col1
		, <&gpio1 11 GPIO_ACTIVE_HIGH>   //Col2
		, <&gpio0 4 GPIO_ACTIVE_HIGH>   //Col1
		, <&gpio0 5 GPIO_ACTIVE_HIGH>   //Col1
		, <&gpio1 11 GPIO_ACTIVE_HIGH>   //Col2
		;
};

